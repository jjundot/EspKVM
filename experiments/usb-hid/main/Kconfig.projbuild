## experiments/usb-hid/main/Kconfig.projbuild
```kconfig
menu "HID hardware bring-up"
config HID_TEST_BUTTON_GPIO
    int "Arm/mode button GPIO"
    range 0 48
    default 0
config HID_TEST_FORCE_6KRO
    bool "Default to standard 6KRO descriptors"
    default n
config HID_TEST_USB_VID
    hex "USB vendor ID (must be authorized for your use)"
    range 0x0000 0xffff
    default 0x046d
config HID_TEST_USB_PID
    hex "USB product ID"
    range 0x0000 0xffff
    default 0xc52b
endmenu
```

## experiments/usb-hid/sdkconfig.defaults
```kconfig
CONFIG_IDF_TARGET="esp32s3"
CONFIG_FREERTOS_HZ=1000
CONFIG_TINYUSB_HID_COUNT=3
CONFIG_TINYUSB_CDC_ENABLED=n
CONFIG_ESP_CONSOLE_UART_DEFAULT=y
CONFIG_LOG_DEFAULT_LEVEL_INFO=y
CONFIG_ESP_MAIN_TASK_STACK_SIZE=8192
```

## sources/device/sdkconfig.defaults
```kconfig
CONFIG_IDF_TARGET="esp32s3"
CONFIG_ESP_CONSOLE_UART_DEFAULT=y
CONFIG_ESP_CONSOLE_UART_NUM=0
CONFIG_ESP_CONSOLE_UART_BAUDRATE=115200
CONFIG_LOG_DEFAULT_LEVEL_INFO=y
CONFIG_BOOTLOADER_LOG_LEVEL_NONE=y
CONFIG_PARTITION_TABLE_CUSTOM=y
CONFIG_PARTITION_TABLE_CUSTOM_FILENAME="partitions.csv"
CONFIG_FREERTOS_HZ=1000
CONFIG_ESP_MAIN_TASK_STACK_SIZE=8192
CONFIG_TINYUSB_HID_COUNT=3
CONFIG_TINYUSB_CDC_ENABLED=n
```
